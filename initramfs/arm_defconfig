## tools/buildroot-external-peridio-platform/configs/peridio_platform_defconfig
```kconfig
# Global settings
BR2_TAR_OPTIONS="--no-same-owner"
BR2_BACKUP_SITE="http://dl.peridio.com"
BR2_ENABLE_DEBUG=y
BR2_OPTIMIZE_2=y
BR2_GLOBAL_PATCH_DIR="${BR2_EXTERNAL_PERIDIO_PLATFORM_PATH}/patches"
BR2_ROOTFS_DEVICE_TABLE="${BR2_EXTERNAL_PERIDIO_PLATFORM_PATH}/board/peridio-common/device_table.txt"
BR2_SYSTEM_DEFAULT_PATH="/bin:/sbin:/usr/bin:/usr/sbin"
BR2_ENABLE_LOCALE_WHITELIST="locale-archive"
BR2_GENERATE_LOCALE="en_US.UTF-8"
BR2_ROOTFS_OVERLAY="${BR2_EXTERNAL_PERIDIO_PLATFORM_PATH}/board/peridio-common/rootfs_overlay ${PERIDIO_DEFCONFIG_DIR}/rootfs_overlay"
BR2_ROOTFS_POST_BUILD_SCRIPT="${PERIDIO_DEFCONFIG_DIR}/post-build.sh ${BR2_EXTERNAL_PERIDIO_PLATFORM_PATH}/board/peridio-common/post-build.sh"
BR2_ROOTFS_POST_IMAGE_SCRIPT="${PERIDIO_DEFCONFIG_DIR}/post-createfs.sh"
BR2_REPRODUCIBLE=y
BR2_ROOTFS_SKELETON_CUSTOM=y
BR2_ROOTFS_SKELETON_CUSTOM_PATH="${BR2_EXTERNAL_PERIDIO_PLATFORM_PATH}/board/peridio-common/skeleton"
BR2_INIT_SYSTEMD=y
BR2_PACKAGE_F2FS_TOOLS=y
BR2_PACKAGE_RNG_TOOLS=y
BR2_PACKAGE_NCURSES=y
# BR2_PACKAGE_RNG_TOOLS_JITTERENTROPY_LIBRARY is not set
BR2_PACKAGE_UBOOT_TOOLS=y
BR2_PACKAGE_CA_CERTIFICATES=y
BR2_PACKAGE_DOCKER_CLI=y
BR2_PACKAGE_DOCKER_COMPOSE=y
BR2_PACKAGE_DOCKER_ENGINE=y
BR2_PACKAGE_DOCKER_ENGINE_DRIVER_BTRFS=y
BR2_PACKAGE_DOCKER_ENGINE_DRIVER_DEVICEMAPPER=y
BR2_PACKAGE_DOCKER_ENGINE_DRIVER_VFS=y
BR2_TARGET_ROOTFS_SQUASHFS=y
# BR2_TARGET_ROOTFS_TAR is not set
BR2_PACKAGE_CRYPTOAUTHLIB=y
BR2_PACKAGE_LIBP11=y
BR2_PACKAGE_P11_KIT=y

BR2_PACKAGE_PERIDIO_INITRAMFS=y
BR2_PACKAGE_BOARDID=y

# peridiod 
BR2_PACKAGE_HOST_FWUP=y
BR2_PACKAGE_PERIDIOD=y
BR2_PACKAGE_LIBMNL=y
BR2_PACKAGE_ERLANG=y
BR2_PACKAGE_FWUP=y
BR2_PACKAGE_GNUTLS=y
BR2_PACKAGE_GNUTLS_TOOLS=y
```

## tools/buildroot-external-peridio-platform/package/peridio-initramfs/Config.in
```kconfig
config BR2_PACKAGE_PERIDIO_INITRAMFS
	bool "peridio-initramfs"
	help
	  An initramfs to enable overlayfs on Peridio Platforms.
```
